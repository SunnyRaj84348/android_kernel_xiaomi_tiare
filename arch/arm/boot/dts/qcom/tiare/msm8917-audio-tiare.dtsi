/*
 * Copyright (c) 2016, The Linux Foundation. All rights reserved.
 *
 * This program is free software; you can redistribute it and/or modify
 * it under the terms of the GNU General Public License version 2 and
 * only version 2 as published by the Free Software Foundation.
 *
 * This program is distributed in the hope that it will be useful,
 * but WITHOUT ANY WARRANTY; without even the implied warranty of
 * MERCHANTABILITY or FITNESS FOR A PARTICULAR PURPOSE.  See the
 * GNU General Public License for more details.
 */

&int_codec {
	ext-spk-amp-gpio;
	headset-gpio = <&tlmm 129 0>;
	qcom,msm-micbias2-ext-cap;
};

&i2c_6 {
	status = "ok";
	aw87329@58 {
		compatible = "awinic,aw87329_pa";
		reg = <0x58>;
		reset-gpio = <&tlmm 124 0>;
		status = "ok";
	};
};
