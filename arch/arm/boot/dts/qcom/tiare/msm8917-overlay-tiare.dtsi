#include "msm8917-tiare.dtsi"
#include "msm8917-audio-tiare.dtsi"
#include "msm8917-camera-pinctrl-tiare.dtsi"
#include "msm8917-camera-sensor-qrd-tiare.dtsi"
#include "msm8917-mdss-tiare.dtsi"
#include "msm8917-memory-tiare.dtsi"
#include "msm8917-pinctrl-tiare.dtsi"
#include "msm8917-pm-tiare.dtsi"
#include "msm8917-regulator-tiare.dtsi"
#include "msm8917-sku5-tiare.dtsi"
#include "msm8917-spmi-tiare.dtsi"
